/*
 * textures.c
 *
 * Текстуры и работа с ними для демо-проекта
 *
 *
 *  https://www.youtube.com/@VadRov
 *  https://dzen.ru/vadrov
 *  https://vk.com/vadrov
 *  https://t.me/vadrov_channel
 *
 *  Created on: Feb 12, 2023
 *      Author: VadRov
 */

#include "textures.h"

const uint16_t image_data_melnica[] = {
	    0x0000, 0x0000, 0x0000, 0x0000, 0x0000, 0x0000, 0x0000, 0x0000,
	    0x0000, 0x0000, 0x0000, 0x0000, 0x0000, 0x0000, 0x0000, 0x0000,
	    0x0000, 0x0000, 0x0000, 0x0000, 0x0000, 0x0000, 0x0000, 0x0000,
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	    0x0000, 0x0000, 0x0000, 0x0000
};

const uint16_t image_data_kamen[1600] = {
	0xf555, 0xf666, 0xf666, 0xf666, 0xf666, 0xf666, 0xf655, 0xf655,
    0xf555, 0xf444, 0xf444, 0xf555, 0xf555, 0xf655, 0xf655, 0xf555,
    0xf555, 0xf555, 0xf555, 0xf555, 0xf444, 0xf555, 0xf555, 0xf555,
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    0xf444, 0xf444, 0xf434, 0xf434, 0xf434, 0xf434, 0xf333, 0xf434
    };

const MGL_IMAGE image_melnica = { image_data_melnica, 97, 100, MGL_IMAGE_COLOR_A4R4G4B4 };
const MGL_IMAGE image_kamen   = { image_data_kamen, 40, 40, MGL_IMAGE_COLOR_A4R4G4B4 };

uint32_t MGL_Color_gradient(uint32_t color1, uint32_t color2, uint8_t a)
{
	uint8_t r_col1 = (color1 >> 16) & 0xff;
	uint8_t g_col1 = (color1 >> 8) & 0xff;
	uint8_t b_col1 = color1 & 0xff;

	uint8_t r_col2 = (color2 >>16) & 0xff;
	uint8_t g_col2 = (color2 >> 8) & 0xff;
	uint8_t b_col2 = color2 & 0xff;

	r_col1 -= (a * (r_col1 - r_col2)) / 255;
	g_col1 -= (a * (g_col1 - g_col2)) / 255;
	b_col1 -= (a * (b_col1 - b_col2)) / 255;

	return (((uint32_t)r_col1) << 16) | (((uint32_t)g_col1) << 8) | ((uint32_t)b_col1);
}

static uint32_t MGL_NewColor(uint16_t col_f, uint32_t color_obj, uint8_t a)
{
	uint8_t r = (color_obj>>16) & 0xff;
	uint8_t g = (color_obj>>8)  & 0xff;
	uint8_t b = color_obj & 0xff;
	if (a) {
		uint8_t r_f = (col_f >> 8) & 0xF8;
		uint8_t g_f = (col_f >> 3) & 0xFC;
		uint8_t b_f = (col_f << 3) & 0xF8;
		r -= (a * (r - r_f)) / 255;
		g -= (a * (g - g_f)) / 255;
		b -= (a * (b - b_f)) / 255;
	}
	return (uint32_t)((r << 16) | (g << 8) | b);
}

void Draw_Texture(LCD_Handler *lcd, int x, int y, const MGL_IMAGE *image)
{
	if (!image) return;
	if (x < 0 || y < 0) return;
	if ((x >= lcd->Width) || (y >= lcd->Height) || (x + image->w - 1) >= lcd->Width || (y + image->h - 1) >= lcd->Height) return;
	const void *pix_col;
	uint32_t pix_col32;
	uint8_t r = 0, g = 0, b = 0;
	uint8_t data_width = 2;
	if (image->mode == MGL_IMAGE_COLOR_R3G3B2) {
		data_width = 1;
	}
	else if (image->mode == MGL_IMAGE_COLOR_R8G8B8) {
		data_width = 3;
	}
	else if (image->mode == MGL_IMAGE_COLOR_A8R8G8B8) {
		data_width = 4;
	}
	for (int i = 0; i < image->h; i++) {
		for (int j = 0; j < image->w; j++) {
			pix_col = image->data + (i * image->w + j) * data_width;
			if (image->mode == MGL_IMAGE_COLOR_R3G3B2) {
				uint8_t c8 = *((uint8_t*)pix_col);
				r = c8 & 0b11100000;
				g = (c8 << 3) & 0b11100000;
				b = (c8 << 6) & 0b11000000;
			}
			else if (image->mode == MGL_IMAGE_COLOR_R5G6B5) {
				uint16_t c16 = *((uint16_t*)pix_col);
				r = (c16 >> 8) & 0xF8;
				g = (c16 >> 3) & 0xFC;
				b = (c16 << 3) & 0xF8;
			}
			else if (image->mode == MGL_IMAGE_COLOR_A4R4G4B4) {
				uint16_t c16 = *((uint16_t*)pix_col);
				if (!(c16 & 0xF000)) continue; //абсолютно прозрачен? если да, то пропускаем
				r = (c16 >> 4) & 0xF0;
				g = c16 & 0xF0;
				b = (c16 << 4) & 0xF0;
			}
			else if (image->mode == MGL_IMAGE_COLOR_R8G8B8) {
				uint8_t *c24 = (uint8_t*)pix_col;
				r = c24[0];
				g = c24[1];
				b = c24[2];
			}
			else if (image->mode == MGL_IMAGE_COLOR_A8R8G8B8) {
				uint32_t c32 = *((uint32_t*)pix_col);
				if (!(c32 & 0xFF000000)) continue; //абсолютно прозрачен? если да, то пропускаем
				r = (c32 >> 16) & 0xFF;
				g = (c32 >> 8) & 0xFF;
				b = c32 & 0xFF;
			}
			pix_col32 = (r << 16) | (g << 8) | b;
			uint16_t data_pix;
			LCD_ReadImage(lcd, j + x, i + y, 1, 1, &data_pix);
			LCD_DrawPixel(lcd, j + x, i + y, MGL_NewColor(data_pix, pix_col32, 0));
		}
	}
}
